/**
 * These arguments were used when this file was generated. They will be automatically applied on subsequent loads
 * via the GUI or CLI. Run CLI with '--help' for additional information on how to override these arguments.
 * @cliArgs --device "F28P65x" --part "F28P65x_100PZP" --package "100PZP" --context "CPU1" --product "C2000WARE@6.00.01.00"
 * @v2CliArgs --device "TMS320F28P650DK" --package "100PZP" --variant "TMS320F28P650DK6" --context "CPU1" --product "C2000WARE@6.00.01.00"
 * @versions {"tool":"1.26.1+4441"}
 */
